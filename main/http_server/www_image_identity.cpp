#include "www_image_identity.h"

#include <cstring>

namespace {

constexpr char IDENTITY_MAGIC[] = "NERDQAXEPLUS_WEB_IDENTITY_V1";
constexpr char VERSION_PREFIX[] = "\nVERSION_TAG=";
constexpr char COMMIT_PREFIX[] = "COMMIT_HASH=";
constexpr size_t MAX_VERSION_LENGTH = 128;
constexpr size_t MAX_COMMIT_LENGTH = 64;
constexpr size_t NOT_FOUND = static_cast<size_t>(-1);

size_t find_sequence(const uint8_t *contents, size_t contents_size, const char *sequence, size_t sequence_size,
                     size_t start)
{
    if (!contents || !sequence || sequence_size == 0 || start > contents_size ||
        sequence_size > contents_size - start) {
        return NOT_FOUND;
    }

    const size_t last_start = contents_size - sequence_size;
    for (size_t offset = start; offset <= last_start; ++offset) {
        if (contents[offset] == static_cast<uint8_t>(sequence[0]) &&
            memcmp(contents + offset, sequence, sequence_size) == 0) {
            return offset;
        }
    }
    return NOT_FOUND;
}

bool consume_literal(const uint8_t *contents, size_t contents_size, size_t &cursor, const char *literal,
                     size_t literal_size)
{
    if (!literal || cursor > contents_size || literal_size > contents_size - cursor ||
        memcmp(contents + cursor, literal, literal_size) != 0) {
        return false;
    }
    cursor += literal_size;
    return true;
}

bool is_identity_value_byte(uint8_t byte)
{
    // Identity values generated by the release preflight are printable,
    // whitespace-free ASCII.
    return byte >= 0x21 && byte <= 0x7e;
}

bool is_commit_byte(uint8_t byte)
{
    return (byte >= '0' && byte <= '9') || (byte >= 'A' && byte <= 'Z') ||
           (byte >= 'a' && byte <= 'z') || byte == '.' || byte == '_' || byte == '-';
}

bool read_line_value(const uint8_t *contents, size_t contents_size, size_t &cursor, size_t max_length,
                     bool (*is_allowed)(uint8_t), size_t &value_start, size_t &value_length)
{
    value_start = cursor;
    value_length = 0;

    while (cursor < contents_size && contents[cursor] != '\n') {
        if (value_length >= max_length || !is_allowed(contents[cursor])) {
            return false;
        }
        ++cursor;
        ++value_length;
    }

    if (value_length == 0 || cursor >= contents_size || contents[cursor] != '\n') {
        return false;
    }
    ++cursor;
    return true;
}

bool bounded_expected_version_length(const char *version, size_t &length)
{
    if (!version) {
        return false;
    }

    length = 0;
    while (length <= MAX_VERSION_LENGTH && version[length] != '\0') {
        if (!is_identity_value_byte(static_cast<uint8_t>(version[length]))) {
            return false;
        }
        ++length;
    }
    return length > 0 && length <= MAX_VERSION_LENGTH;
}

} // namespace

WwwImageIdentityStatus validate_nerdqaxeplus_www_image(const uint8_t *image, size_t image_size,
                                                       const char *expected_version)
{
    size_t expected_version_length = 0;
    if (!image || image_size == 0 || !bounded_expected_version_length(expected_version, expected_version_length)) {
        return WwwImageIdentityStatus::INVALID_ARGUMENT;
    }

    constexpr size_t magic_length = sizeof(IDENTITY_MAGIC) - 1;
    const size_t identity_offset = find_sequence(image, image_size, IDENTITY_MAGIC, magic_length, 0);
    if (identity_offset == NOT_FOUND) {
        return WwwImageIdentityStatus::MISSING;
    }
    if (find_sequence(image, image_size, IDENTITY_MAGIC, magic_length, identity_offset + 1) != NOT_FOUND) {
        return WwwImageIdentityStatus::DUPLICATE;
    }

    size_t cursor = identity_offset + magic_length;
    if (!consume_literal(image, image_size, cursor, VERSION_PREFIX, sizeof(VERSION_PREFIX) - 1)) {
        return WwwImageIdentityStatus::MALFORMED;
    }

    size_t embedded_version_start = 0;
    size_t embedded_version_length = 0;
    if (!read_line_value(image, image_size, cursor, MAX_VERSION_LENGTH, is_identity_value_byte,
                         embedded_version_start, embedded_version_length) ||
        !consume_literal(image, image_size, cursor, COMMIT_PREFIX, sizeof(COMMIT_PREFIX) - 1)) {
        return WwwImageIdentityStatus::MALFORMED;
    }

    size_t commit_start = 0;
    size_t commit_length = 0;
    if (!read_line_value(image, image_size, cursor, MAX_COMMIT_LENGTH, is_commit_byte, commit_start, commit_length)) {
        return WwwImageIdentityStatus::MALFORMED;
    }
    (void) commit_start;
    (void) commit_length;

    if (embedded_version_length != expected_version_length ||
        memcmp(image + embedded_version_start, expected_version, expected_version_length) != 0) {
        return WwwImageIdentityStatus::VERSION_MISMATCH;
    }

    return WwwImageIdentityStatus::OK;
}

const char *www_image_identity_status_message(WwwImageIdentityStatus status)
{
    switch (status) {
    case WwwImageIdentityStatus::OK:
        return "WWW image identity is valid";
    case WwwImageIdentityStatus::INVALID_ARGUMENT:
        return "WWW image identity could not be validated";
    case WwwImageIdentityStatus::MISSING:
        return "WWW image identity is missing";
    case WwwImageIdentityStatus::DUPLICATE:
        return "WWW image contains duplicate identities";
    case WwwImageIdentityStatus::MALFORMED:
        return "WWW image identity is malformed";
    case WwwImageIdentityStatus::VERSION_MISMATCH:
        return "WWW image version does not match the expected firmware";
    default:
        return "WWW image identity validation failed";
    }
}
